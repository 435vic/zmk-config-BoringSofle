## boards/shields/boring_sofle/Kconfig.defconfig
```kconfig
if SHIELD_BORING_SOFLE_LEFT

config ZMK_KEYBOARD_NAME
    default "boring_sofle"

config ZMK_SPLIT_ROLE_CENTRAL
    default y

endif # SHIELD_BORING_SOFLE_LEFT

if SHIELD_BORING_SOFLE_LEFT || SHIELD_BORING_SOFLE_RIGHT

config ZMK_SPLIT
    default y

endif # SHIELD_BORING_SOFLE_LEFT || SHIELD_BORING_SOFLE_RIGHT
```

## boards/shields/boring_sofle/Kconfig.shield
```kconfig
config SHIELD_BORING_SOFLE_LEFT
    def_bool $(shields_list_contains,boring_sofle_left)

config SHIELD_BORING_SOFLE_RIGHT
    def_bool $(shields_list_contains,boring_sofle_right)
```
